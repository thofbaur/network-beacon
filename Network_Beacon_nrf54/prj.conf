## prj.conf
```kconfig
CONFIG_BT=y
CONFIG_BT_BROADCASTER=y
CONFIG_BT_OBSERVER=y
CONFIG_BT_PERIPHERAL=y
CONFIG_BT_GATT_CLIENT=y
CONFIG_BT_MAX_CONN=1
CONFIG_BT_NUS=y
CONFIG_BT_USER_DATA_LEN_UPDATE=y
CONFIG_BT_USER_PHY_UPDATE=y
CONFIG_BT_GAP_AUTO_UPDATE_CONN_PARAMS=n
CONFIG_BT_BUF_ACL_RX_SIZE=251
CONFIG_BT_ATT_TX_COUNT=10
CONFIG_BT_L2CAP_TX_MTU=498
CONFIG_BT_CONN_TX_MAX=10
CONFIG_BT_BUF_EVT_RX_COUNT=11
CONFIG_BT_BUF_ACL_TX_COUNT=10
CONFIG_BT_BUF_ACL_TX_SIZE=502
CONFIG_BT_CTLR_DATA_LENGTH_MAX=251
CONFIG_BT_CTLR_PHY_2M=y
CONFIG_LOG=y # TODO: set to no for release
CONFIG_PRINTK=y  # TODO: set to no for release
CONFIG_CONSOLE=y # TODO: set to no for release
CONFIG_UART_CONSOLE=y  # TODO: set to no for release
CONFIG_BT_DEVICE_NAME="DSA"
CONFIG_BT_FILTER_ACCEPT_LIST=y
CONFIG_ADC=y
CONFIG_GPIO=y
CONFIG_FLASH=y
CONFIG_FLASH_MAP=y
CONFIG_NVS=y
CONFIG_SETTINGS=y
CONFIG_SETTINGS_NVS=y
CONFIG_PM_PARTITION_SIZE_SETTINGS_STORAGE=0x8000
CONFIG_PM=y
CONFIG_PM_DEVICE=y
```

## src/main.c
```c
/* main.c - Application main entry point */

/*
 * Copyright (c) 2015-2016 Intel Corporation
 *
 * SPDX-License-Identifier: Apache-2.0
 */

#include <zephyr/types.h>
#include <stddef.h>
#include <zephyr/kernel.h>
#include <zephyr/sys/printk.h>
#include <zephyr/sys/util.h>

#include <zephyr/bluetooth/bluetooth.h>

#include "radio.h"
#include "network.h"
#include "led.h"

int main(void)
{
    int err;


	printk("Starting DSA Network Beacon\n");
	led_init();
	network_init();
	/* Initialize the Bluetooth Subsystem */
	err = radio_init();
	if (err) {
		printk("Radio initialization failed (err %d)\n", err);
		return err;
	}

	/* Start advertising and scanning*/
	err = radio_start();
	if (err) {
		printk("Radio start failed (err %d)\n", err);
		return err;
	}

	k_sleep(K_FOREVER);
	return 0;
}
```

## src/defines.h
```c
#ifndef DEFINES_H
#define DEFINES_H

#define DSA_NUS_FLAG_TIME     0x01
#define DSA_NUS_FLAG_DATA       0x02
#define DSA_NUS_FLAG_VOLTAGE    0x03

#define P_NULL				0
// Param_Base_Mask = 0xE0 -> Possible Values: 000 ... 111 << 5
#define P_BASE_MASK			0xE0
#define P_BASE_MAIN			0x20
#define P_BASE_NETWORK		0x60
#define P_BASE_RADIO		0x80

// Defines for Main Parameters should be in one block
#define P_MAIN_LED_ACTIVE       (P_BASE_MAIN + 1)
#define P_MAIN_RESET_PARAMS		(P_BASE_MAIN + 12)

// Defines for Network Parameters should be in one block
#define P_RSSI_NETWORK		    (P_BASE_NETWORK + 4)
#define P_NETWORK_RESET_PARAMS 	(P_BASE_NETWORK + 12)
#define P_TRACKING_ACTIVE 	    (P_BASE_NETWORK + 13)

// Defines for Radio Parameters should be in one block
#define P_ADV_INTERVAL_MS			(P_BASE_RADIO + 1)
#define P_ADV_INTERVAL_LOWACTIVITY_MS	(P_BASE_RADIO + 2)
#define P_SCAN_INTERVAL_MS			(P_BASE_RADIO + 3)
#define P_SCAN_INTERVAL_LOWACTIVITY_MS	(P_BASE_RADIO + 4)
#define P_SCAN_WINDOW_MS			(P_BASE_RADIO + 5)
#define P_SCAN_WINDOW_LOWACTIVITY_MS	(P_BASE_RADIO + 6)
#define P_RADIO_RESET_PARAMS	(P_BASE_RADIO + 12)
#define P_SET_RAD_ACTIVE		(P_BASE_RADIO + 13)

#endif /* DEFINES_H */
```

## src/device.c
```c
#include <zephyr/bluetooth/bluetooth.h>
#include "radio_ids.h"
#include "device.h"

struct device_status {
    uint8_t radio;
    uint8_t network;
};

static struct device_status status_device;

uint8_t lookup_device_id(const bt_addr_le_t *addr)
{
    for (size_t i = 0; i < ARRAY_SIZE(known_device_table); i++) {
        if (bt_addr_le_cmp(addr, &known_device_table[i].addr) == 0) {
            return known_device_table[i].id;
        }
    }

    return 0xff; // unknown / unassigned
}

uint8_t get_device_id()
{
    static uint8_t device_id = 0xff;

    bt_addr_le_t addrs[CONFIG_BT_ID_MAX];
    size_t count = CONFIG_BT_ID_MAX;

    // Retrieve all addresses registered for the Bluetooth stack
    bt_id_get(addrs, &count);

    if (count > 0) {
		device_id = lookup_device_id(&addrs[0]);

        char addr_str[BT_ADDR_LE_STR_LEN];
        bt_addr_le_to_str(&addrs[0], addr_str, sizeof(addr_str));
	} else {
		printk("No Bluetooth identity address available, using unknown device id\n");
	}
	return device_id;
}

uint8_t device_get_radio_status(void)
{
    return status_device.radio;
}

void device_set_radio_status(uint8_t status)
{
    status_device.radio = status;
}

void device_set_radio_status_bit(uint8_t mask, bool active)
{
    if (active) {
        status_device.radio |= mask;
    } else {
        status_device.radio &= ~mask;
    }
}

uint8_t device_get_network_status(void)
{
    return status_device.network;
}

void device_set_network_status(uint8_t status)
{
    status_device.network = status;
}
```

## src/device.h
```c
#pragma once

#include <stdbool.h>
#include <stdint.h>

#include <zephyr/bluetooth/addr.h>

uint8_t get_device_id(void);
uint8_t lookup_device_id(const bt_addr_le_t *addr);

uint8_t device_get_radio_status(void);
void device_set_radio_status(uint8_t status);
void device_set_radio_status_bit(uint8_t mask, bool active);

uint8_t device_get_network_status(void);
void device_set_network_status(uint8_t status);
```

## src/led.c
```c
#include <errno.h>
#include <stdbool.h>
#include <string.h>

#include <zephyr/device.h>
#include <zephyr/devicetree.h>
#include <zephyr/drivers/gpio.h>
#include <zephyr/kernel.h>
#include <zephyr/sys/printk.h>

#include "defines.h"
#include "led.h"
#include "param_storage.h"

#define LED_PARAMS_STORAGE_KEY "dsa/main"
#define LED_BLINK_INTERVAL_MS 20000 // TODO  increase for production
#define LED_BLINK_ON_MS 30

#if DT_NODE_HAS_STATUS(DT_ALIAS(green_led), okay)
#define LED_NODE DT_ALIAS(green_led)
#define LED_ALIAS_NAME "green_led"
#else
#define LED_NODE DT_ALIAS(led0)
#define LED_ALIAS_NAME "led0"
#endif

struct led_params {
	bool led_active;
};

static struct led_params params_led;
static const struct gpio_dt_spec led = GPIO_DT_SPEC_GET_OR(LED_NODE, gpios, { 0 });
static bool led_ready;
static bool led_on;

static void led_blink_handler(struct k_work *work);

static K_WORK_DELAYABLE_DEFINE(led_blink_work, led_blink_handler);

static void led_params_reset(void)
{
	params_led.led_active = true;
}

static int led_set(bool on)
{
	int err;

	if (!led_ready) {
		return -ENODEV;
	}

	err = gpio_pin_set_dt(&led, on ? 1 : 0);
	if (!err) {
		led_on = on;
	}

	return err;
}

static void led_schedule_next_blink(void)
{
	if (led_ready && params_led.led_active) {
		k_work_reschedule(&led_blink_work, K_MSEC(LED_BLINK_INTERVAL_MS));
	}
}

static void led_stop_blinking(void)
{
	k_work_cancel_delayable(&led_blink_work);
	led_set(false);
}

static void led_blink_handler(struct k_work *work)
{
	ARG_UNUSED(work);

	if (!led_ready || !params_led.led_active) {
		led_set(false);
		return;
	}

	if (led_on) {
		led_set(false);
		led_schedule_next_blink();
		return;
	}

	if (!led_set(true)) {
		k_work_reschedule(&led_blink_work, K_MSEC(LED_BLINK_ON_MS));
	}
}

static void led_gpio_init(void)
{
	int err;

	if (!led.port) {
		printk("LED alias %s not available\n", LED_ALIAS_NAME);
		return;
	}

	if (!device_is_ready(led.port)) {
		printk("LED GPIO device not ready\n");
		return;
	}

	err = gpio_pin_configure_dt(&led, GPIO_OUTPUT_INACTIVE);
	if (err) {
		printk("LED configure failed (err %d)\n", err);
		return;
	}

	led_ready = true;
	led_schedule_next_blink();
}

void led_init(void)
{
	int err;

	led_params_reset();
	err = led_params_load();
	if (err == -ENOENT) {
		printk("No stored LED parameters, using defaults\n");
	} else if (err) {
		printk("Failed to load LED parameters (err %d), using defaults\n", err);
	}

	led_gpio_init();
}

void led_apply_command(uint8_t parameter, uint16_t value)
{
	struct led_params old_params_led = params_led;

	switch (parameter) {
	case P_MAIN_LED_ACTIVE:
		params_led.led_active = value != 0;
		printk("LED blink %s\n", params_led.led_active ? "enabled" : "disabled");
		if (params_led.led_active) {
			led_schedule_next_blink();
		} else {
			led_stop_blinking();
		}
		break;
	case P_MAIN_RESET_PARAMS:
		led_params_reset();
		led_schedule_next_blink();
		printk("LED parameters reset\n");
		break;
	default:
		printk("Unknown LED parameter 0x%02x value %u\n", parameter, value);
		break;
	}

	if (memcmp(&old_params_led, &params_led, sizeof(params_led)) != 0) {
		int err = led_params_save();

		if (err) {
			printk("Failed to save LED parameters (err %d)\n", err);
		}
	}
}

int led_params_load(void)
{
	return param_storage_load(LED_PARAMS_STORAGE_KEY,
				  &params_led, sizeof(params_led));
}

int led_params_save(void)
{
	return param_storage_save(LED_PARAMS_STORAGE_KEY,
				  &params_led, sizeof(params_led));
}
```

## src/led.h
```c
#ifndef LED_H
#define LED_H

#include <stdint.h>

void led_init(void);
void led_apply_command(uint8_t parameter, uint16_t value);
int led_params_load(void);
int led_params_save(void);

#endif /* LED_H */
```

## src/network.c
```c
#include <errno.h>
#include <string.h>

#include <zephyr/bluetooth/bluetooth.h>
#include <zephyr/kernel.h>
#include <zephyr/sys/printk.h>

#include "defines.h"
#include "device.h"
#include "network.h"
#include "param_storage.h"
#include "radio.h"

#define NETWORK_PARAMS_STORAGE_KEY "dsa/network"

struct network_params {
	uint8_t 	rssi_threshold;	
};

static struct network_params params_network;

typedef struct {
	uint8_t     id;
	uint8_t     time[3];
	uint8_t     rssi;  // negative value, e.g., -80 dBm is stored as 80
} contact_entry;
#define CONTACT_ENTRY_SIZE 5





#define LENGTH_DATA_BUFFER 26000

#define NETWORK_LIMIT_RSSI		80 // approx. 1-2m distance

#define DATA_LEVEL_1	0
#define DATA_LEVEL_2	1
#define DATA_LEVEL_3	2   // TODO 10
#define DATA_LEVEL_4	3   // TODO 100
#define DATA_LEVEL_5	500
#define DATA_LEVEL_6	1000
#define DATA_LEVEL_7	2000

#define P_SHIFT_STATUS_DATA 5
static contact_entry	data_array[LENGTH_DATA_BUFFER]; // ID 1 Byte; time 3 Byte; RSSI 1 Byte
static uint16_t idx_read = 0;
static uint16_t idx_write = 0;
static uint16_t contact_count = 0;
static K_MUTEX_DEFINE(contact_lock);

static void contact_time_put(uint8_t time[3], uint32_t uptime_s)
{
	time[0] = (uptime_s >> 16) & 0xff;
	time[1] = (uptime_s >> 8) & 0xff;
	time[2] = uptime_s & 0xff;
}

static void reset_parameters(void)
{
	params_network.rssi_threshold = NETWORK_LIMIT_RSSI;

}


void network_init(void)
{
	int err;

	reset_parameters();
	err = network_params_load();
	if (err == -ENOENT) {
		printk("No stored network parameters, using defaults\n");
	} else if (err) {
		printk("Failed to load network parameters (err %d), using defaults\n", err);
	}
}

void network_apply_command(uint8_t parameter, uint16_t value)
{
	struct network_params old_params_network = params_network;

	switch (parameter) {
	case P_RSSI_NETWORK:
		if (value > UINT8_MAX) {
			printk("Rejecting invalid RSSI threshold value %u\n", value);
			return;
		}
		params_network.rssi_threshold = (uint8_t)value;
		printk("Network RSSI threshold set to -%u dBm\n", params_network.rssi_threshold);
		break;
	case P_NETWORK_RESET_PARAMS:
		reset_parameters();
		printk("Network parameters reset\n");
		break;
	case P_TRACKING_ACTIVE:
		printk("Network tracking command value %u not implemented\n", value);
		break;
	default:
		printk("Unknown network parameter 0x%02x value %u\n", parameter, value);
		break;
	}

	if (memcmp(&old_params_network, &params_network, sizeof(params_network)) != 0) {
		int err = network_params_save();

		if (err) {
			printk("Failed to save network parameters (err %d)\n", err);
		}
	}
}

int network_params_load(void)
{
	return param_storage_load(NETWORK_PARAMS_STORAGE_KEY,
				  &params_network, sizeof(params_network));
}

int network_params_save(void)
{
	return param_storage_save(NETWORK_PARAMS_STORAGE_KEY,
				  &params_network, sizeof(params_network));
}

static bool scan_extract_id(struct bt_data *data, void *user_data)
{
    uint8_t *id = user_data;
    
    if (data->type == BT_DATA_MANUFACTURER_DATA)
    {
        data->data_len >= 1 ? (*id = data->data[0]) : (*id = 0);
        
        return false;
    }

    return true;
}

static uint8_t contact_status_from_count(uint16_t number_dataset)
{
	if (number_dataset > DATA_LEVEL_7) {
		return 7 << P_SHIFT_STATUS_DATA;
	}
	if (number_dataset > DATA_LEVEL_6) {
		return 6 << P_SHIFT_STATUS_DATA;
	}
	if (number_dataset > DATA_LEVEL_5) {
		return 5 << P_SHIFT_STATUS_DATA;
	}
	if (number_dataset > DATA_LEVEL_4) {
		return 4 << P_SHIFT_STATUS_DATA;
	}
	if (number_dataset > DATA_LEVEL_3) {
		return 3 << P_SHIFT_STATUS_DATA;
	}
	if (number_dataset > DATA_LEVEL_2) {
		return 2 << P_SHIFT_STATUS_DATA;
	}
	if (number_dataset > DATA_LEVEL_1) {
		return 1 << P_SHIFT_STATUS_DATA;
	}

	return 0;
}

void network_update_tag(void)
{
	int err;
	uint16_t number_dataset;

	k_mutex_lock(&contact_lock, K_FOREVER);
	number_dataset = contact_count;
	k_mutex_unlock(&contact_lock);

	device_set_network_status(contact_status_from_count(number_dataset));
	err = adv_update();
	if (err) {
		printk("Failed to update network status advertising data (err %d)\n", err);
	}
}

void network_evaluate_contact(const bt_addr_le_t *addr, 
    int8_t rssi, uint8_t adv_type, struct net_buf_simple *buf)
{
    struct net_buf_simple ad_temp;
    uint8_t id = 0;
    uint8_t rssi_magnitude = (uint8_t)(-(int16_t)rssi);

    if (rssi_magnitude <= params_network.rssi_threshold)
    {
        
        net_buf_simple_clone(buf, &ad_temp);
	    bt_data_parse(&ad_temp, scan_extract_id, &id);
		
		k_mutex_lock(&contact_lock, K_FOREVER);
		data_array[idx_write].id = id;
		contact_time_put(data_array[idx_write].time, (uint32_t)k_uptime_seconds());
		data_array[idx_write].rssi = rssi_magnitude;
		idx_write = (idx_write + 1) % LENGTH_DATA_BUFFER;

		if (contact_count == LENGTH_DATA_BUFFER) {
			idx_read = (idx_read + 1) % LENGTH_DATA_BUFFER;
		} else {
			contact_count++;
		}
		k_mutex_unlock(&contact_lock);

		network_update_tag();
    }
}

uint8_t network_read_contact(uint8_t *buffer, uint16_t buffer_len)
{
	uint8_t bytes_written = 0;
	bool entries_removed = false;
	
	k_mutex_lock(&contact_lock, K_FOREVER);

	while (contact_count > 0)
	{
		if ((buffer_len - bytes_written) < CONTACT_ENTRY_SIZE) {
			break;
		}

		buffer[bytes_written++] = data_array[idx_read].id;
		buffer[bytes_written++] = data_array[idx_read].time[0];
		buffer[bytes_written++] = data_array[idx_read].time[1];
		buffer[bytes_written++] = data_array[idx_read].time[2];
		buffer[bytes_written++] = data_array[idx_read].rssi;

		idx_read = (idx_read + 1) % LENGTH_DATA_BUFFER;
		contact_count--;
		entries_removed = true;
	}

	k_mutex_unlock(&contact_lock);

	if (entries_removed) {
		network_update_tag();
	}

	return bytes_written;
}
```

## src/network.h
```c
#ifndef NETWORK_H
#define NETWORK_H

#include <stdint.h>

#include <zephyr/bluetooth/addr.h>

struct net_buf_simple;

void network_evaluate_contact(const bt_addr_le_t *addr, 
    int8_t rssi, uint8_t adv_type, struct net_buf_simple *buf);
void network_init(void);
void network_apply_command(uint8_t parameter, uint16_t value);
int network_params_load(void);
int network_params_save(void);
uint8_t network_read_contact(uint8_t *buffer, uint16_t buffer_len);

#endif /* NETWORK_H */
```

## src/nus.c
```c
#include <errno.h>
#include <stdio.h>
#include <string.h>

#include <zephyr/bluetooth/addr.h>
#include <zephyr/bluetooth/conn.h>
#include <zephyr/bluetooth/gatt.h>
#include <zephyr/bluetooth/hci.h>
#include <zephyr/kernel.h>
#include <zephyr/sys/atomic.h>
#include <zephyr/sys/printk.h>
#include <zephyr/sys/byteorder.h>

#include <bluetooth/services/nus.h>

#include "nus.h"
#include "defines.h"
#include "network.h"

#define NUS_CONNECTION_TIMEOUT_MS 20000
#define NUS_ATT_NOTIFY_HEADER_LEN 3
#define NUS_MAX_PAYLOAD_LEN (CONFIG_BT_L2CAP_TX_MTU - NUS_ATT_NOTIFY_HEADER_LEN)

static struct bt_conn *current_conn;
static bool nus_notifications_enabled;
static bool disconnect_when_sent;
static bool transfer_active;
static atomic_t pending_nus_sends;
static struct bt_gatt_exchange_params mtu_exchange_params;

static void connection_timeout_handler(struct k_work *work);

static K_WORK_DELAYABLE_DEFINE(connection_timeout_work, connection_timeout_handler);

static int nus_send_tracked(struct bt_conn *conn, const void *data, uint16_t len)
{
	int err;

	atomic_inc(&pending_nus_sends);
	err = bt_nus_send(conn, data, len);
	if (err) {
		atomic_dec(&pending_nus_sends);
		return err;
	}

	return 0;
}

static void disconnect_nus_connection(struct bt_conn *conn)
{
	if (bt_conn_disconnect(conn, BT_HCI_ERR_REMOTE_USER_TERM_CONN)) {
		printk("Failed to disconnect NUS connection\n");
	}
}

static void refresh_connection_timeout(void)
{
	if (NUS_CONNECTION_TIMEOUT_MS == 0) {
		return;
	}

	k_work_reschedule(&connection_timeout_work, K_MSEC(NUS_CONNECTION_TIMEOUT_MS));
}

static void cancel_connection_timeout(void)
{
	k_work_cancel_delayable(&connection_timeout_work);
}

static void connection_timeout_handler(struct k_work *work)
{
	struct bt_conn *conn;
	int err;

	ARG_UNUSED(work);

	if (!current_conn) {
		return;
	}

	conn = bt_conn_ref(current_conn);
	printk("No NUS data received for %u ms, disconnecting\n", NUS_CONNECTION_TIMEOUT_MS);

	err = bt_conn_disconnect(conn, BT_HCI_ERR_REMOTE_USER_TERM_CONN);
	if (err) {
		printk("Connection timeout disconnect failed (err %d)\n", err);
	}

	bt_conn_unref(conn);
}

static void print_conn_info(struct bt_conn *conn, const char *prefix)
{
	struct bt_conn_info info;
	int err;

	err = bt_conn_get_info(conn, &info);
	if (err) {
		printk("%s: failed to read connection info (err %d)\n", prefix, err);
		return;
	}

	if (info.type != BT_CONN_TYPE_LE) {
		printk("%s: non-LE connection type %u\n", prefix, info.type);
		return;
	}

	printk("%s: role=%s interval=%u us latency=%u timeout=%u units\n",
	       prefix,
	       info.role == BT_CONN_ROLE_PERIPHERAL ? "peripheral" : "central",
	       info.le.interval_us, info.le.latency, info.le.timeout);
}

static void mtu_exchange_cb(struct bt_conn *conn, uint8_t att_err,
			    struct bt_gatt_exchange_params *params)
{
	printk("MTU exchange %s", att_err ? "failed" : "successful");
	if (att_err) {
		printk(" (ATT err 0x%02x)", att_err);
	}
	printk(", negotiated MTU %u\n", bt_gatt_get_mtu(conn));
}

static void request_connection_params(struct bt_conn *conn)
{
	int err;
	const struct bt_conn_le_phy_param phy = {
		.pref_tx_phy = BT_GAP_LE_PHY_2M,
		.pref_rx_phy = BT_GAP_LE_PHY_2M,
	};
	const struct bt_conn_le_data_len_param data_len = {
		.tx_max_len = BT_GAP_DATA_LEN_MAX,
		.tx_max_time = BT_GAP_DATA_TIME_MAX,
	};
	const struct bt_le_conn_param conn_param = {
		.interval_min = BT_GAP_MS_TO_CONN_INTERVAL(7.5),
		.interval_max = BT_GAP_MS_TO_CONN_INTERVAL(15),
		.latency = 0,
		.timeout = BT_GAP_MS_TO_CONN_TIMEOUT(4000),
	};

	printk("Requesting maximum NUS TX connection parameters\n");
	printk("Requested PHY: TX=2M RX=2M\n");
	printk("Requested data length: tx_max_len=%u tx_max_time=%u\n",
	       data_len.tx_max_len, data_len.tx_max_time);
	printk("Requested connection interval: %u-%u units, latency=%u, timeout=%u units\n",
	       conn_param.interval_min, conn_param.interval_max,
	       conn_param.latency, conn_param.timeout);

	mtu_exchange_params.func = mtu_exchange_cb;
	err = bt_gatt_exchange_mtu(conn, &mtu_exchange_params);
	if (err) {
		printk("MTU exchange request failed (err %d)\n", err);
	} else {
		printk("MTU exchange request sent\n");
	}

	err = bt_conn_le_phy_update(conn, &phy);
	if (err) {
		printk("PHY update request failed (err %d)\n", err);
	} else {
		printk("PHY update request sent\n");
	}

	err = bt_conn_le_data_len_update(conn, &data_len);
	if (err) {
		printk("Data length update request failed (err %d)\n", err);
	} else {
		printk("Data length update request sent\n");
	}

	err = bt_conn_le_param_update(conn, &conn_param);
	if (err) {
		printk("Connection parameter update request failed (err %d)\n", err);
	} else {
		printk("Connection parameter update request sent\n");
	}
}

static void send_uptime(struct bt_conn *conn)
{
	uint8_t buffer[1 + sizeof(uint32_t)];

	buffer[0] = DSA_NUS_FLAG_TIME;
	sys_put_be32((uint32_t)k_uptime_seconds(), &buffer[1]);

	if (nus_send_tracked(conn, buffer, sizeof(buffer))) {
		printk("Failed to send NUS uptime response\n");
	}
}

static void send_networkdata(struct bt_conn *conn)
{
	uint16_t max_payload = bt_gatt_get_mtu(conn);
	uint16_t payload_len;
	uint8_t bytes_written = 0;
	uint16_t contact_payload_len;
	uint8_t buffer[NUS_MAX_PAYLOAD_LEN];
	
	if (max_payload > NUS_ATT_NOTIFY_HEADER_LEN) {
		max_payload -= NUS_ATT_NOTIFY_HEADER_LEN;
	} else {
		max_payload = 0;
	}

	printk("NUS max payload: %u bytes\n", max_payload);

	payload_len = MIN(max_payload, (uint16_t)sizeof(buffer));
	if (payload_len <= 1) {
		return;
	}

	contact_payload_len = payload_len - 1;
	buffer[0] = DSA_NUS_FLAG_DATA;

	do {
		bytes_written = network_read_contact(&buffer[1], contact_payload_len);
		if (bytes_written > 0) {
			if (nus_send_tracked(conn, buffer, bytes_written + 1)) {
				printk("Failed to send NUS network data\n");
				return;
			}
		}
	} while (bytes_written > 0);
}


static void nus_received(struct bt_conn *conn, const uint8_t *const data, uint16_t len)
{
	refresh_connection_timeout();

	printk("NUS RX len=%u first=%02x %02x %02x %02x\n", len,
	       len > 0 ? data[0] : 0,
	       len > 1 ? data[1] : 0,
	       len > 2 ? data[2] : 0,
	       len > 3 ? data[3] : 0);

	if (len == 2 && memcmp(data, "st", 2) == 0) {
		if (transfer_active) {
			printk("NUS transfer already active, ignoring start command\n");
			return;
		}

		transfer_active = true;
		printk("Starting sending data\n");
		send_uptime(conn);
		printk("Sent time\n");
		send_networkdata(conn);

		if (nus_send_tracked(conn, "finished", strlen("finished"))) {
			printk("Failed to send NUS finished response\n");
			transfer_active = false;
		} else {
			disconnect_when_sent = true;
		}

	}
}

static void nus_sent(struct bt_conn *conn)
{
	if (atomic_get(&pending_nus_sends) > 0) {
		atomic_dec(&pending_nus_sends);
	}

	if (disconnect_when_sent && atomic_get(&pending_nus_sends) == 0) {
		disconnect_when_sent = false;
		disconnect_nus_connection(conn);
	}
}

static void nus_send_enabled(enum bt_nus_send_status status)
{
	nus_notifications_enabled = (status == BT_NUS_SEND_STATUS_ENABLED);
	printk("NUS TX notifications %s\n", nus_notifications_enabled ? "enabled" : "disabled");
}

static struct bt_nus_cb nus_cb = {
	.received = nus_received,
	.sent = nus_sent,
	.send_enabled = nus_send_enabled,
};

static void connected(struct bt_conn *conn, uint8_t err)
{
	char addr[BT_ADDR_LE_STR_LEN];

	bt_addr_le_to_str(bt_conn_get_dst(conn), addr, sizeof(addr));
	printk("Connection event from %s\n", addr);

	if (err) {
		printk("Connection failed from %s (HCI err 0x%02x)\n", addr, err);
		return;
	}

	printk("Connected: %s\n", addr);
	print_conn_info(conn, "Initial connection parameters");

	if (current_conn) {
		printk("Replacing previous connection reference\n");
		bt_conn_unref(current_conn);
	}

	current_conn = bt_conn_ref(conn);
	refresh_connection_timeout();
	request_connection_params(conn);
}

static void disconnected(struct bt_conn *conn, uint8_t reason)
{
	char addr[BT_ADDR_LE_STR_LEN];

	bt_addr_le_to_str(bt_conn_get_dst(conn), addr, sizeof(addr));
	printk("Disconnected: %s (reason 0x%02x)\n", addr, reason);

	if (current_conn == conn) {
		bt_conn_unref(current_conn);
		current_conn = NULL;
	}

	cancel_connection_timeout();
	nus_notifications_enabled = false;
	disconnect_when_sent = false;
	transfer_active = false;
	atomic_set(&pending_nus_sends, 0);
}

static void le_param_updated(struct bt_conn *conn, uint16_t interval,
			     uint16_t latency, uint16_t timeout)
{
	ARG_UNUSED(conn);

	printk("Connection parameters updated: interval=%u units latency=%u timeout=%u units\n",
	       interval, latency, timeout);
}

static void le_phy_updated(struct bt_conn *conn, struct bt_conn_le_phy_info *param)
{
	ARG_UNUSED(conn);

	printk("PHY updated: TX=%u RX=%u\n", param->tx_phy, param->rx_phy);
}

static void le_data_len_updated(struct bt_conn *conn,
				struct bt_conn_le_data_len_info *info)
{
	ARG_UNUSED(conn);

	printk("Data length updated: tx_len=%u tx_time=%u rx_len=%u rx_time=%u\n",
	       info->tx_max_len, info->tx_max_time,
	       info->rx_max_len, info->rx_max_time);
}

BT_CONN_CB_DEFINE(conn_callbacks) = {
	.connected = connected,
	.disconnected = disconnected,
	.le_param_updated = le_param_updated,
	.le_phy_updated = le_phy_updated,
	.le_data_len_updated = le_data_len_updated,
};

int nus_service_init(void)
{
	int err;

	err = bt_nus_init(&nus_cb);
	if (err) {
		printk("Failed to initialize NUS (err %d)\n", err);
	}

	return err;
}

bool nus_is_connected(void)
{
	return current_conn != NULL;
}
```

## src/nus.h
```c
#ifndef NUS_H
#define NUS_H

#include <stdbool.h>

int nus_service_init(void);
bool nus_is_connected(void);

#endif
```

## src/param_storage.c
```c
#include <errno.h>
#include <stdbool.h>
#include <stddef.h>

#include <zephyr/settings/settings.h>
#include <zephyr/sys/printk.h>

#include "param_storage.h"

static bool settings_initialized;

static int param_storage_init(void)
{
	int err;

	if (settings_initialized) {
		return 0;
	}

	err = settings_subsys_init();
	if (err) {
		printk("Settings init failed (err %d)\n", err);
		return err;
	}

	settings_initialized = true;
	return 0;
}

int param_storage_load(const char *key, void *data, size_t len)
{
	ssize_t loaded;
	int err;

	err = param_storage_init();
	if (err) {
		return err;
	}

	loaded = settings_load_one(key, data, len);
	if (loaded < 0) {
		return loaded;
	}

	if ((size_t)loaded != len) {
		return -EINVAL;
	}

	return 0;
}

int param_storage_save(const char *key, const void *data, size_t len)
{
	int err;

	err = param_storage_init();
	if (err) {
		return err;
	}

	return settings_save_one(key, data, len);
}
```

## src/param_storage.h
```c
#pragma once

#include <stddef.h>

int param_storage_load(const char *key, void *data, size_t len);
int param_storage_save(const char *key, const void *data, size_t len);
```

## src/radio.c
```c
#include <errno.h>
#include <string.h>

#include <zephyr/bluetooth/bluetooth.h>
#include <zephyr/bluetooth/conn.h>
#include <zephyr/bluetooth/gap.h>
#include <zephyr/kernel.h>
#include <zephyr/sys/byteorder.h>
#include <zephyr/sys/util.h>
//#include <bluetooth/scan.h>
#include "defines.h"
#include "radio_ids.h"
#include "network.h"
#include "param_storage.h"
#include "radio.h"
#include "nus.h"
#include "device.h"
#include "led.h"
/* Radio Parameters
 *
 */
#define ADV_INTERVAL_MIN				90 // Advertisement interval in milliseconds
#define ADV_INTERVAL_MAX				120 // Advertisement interval in milliseconds
#define SCAN_WINDOW_MS				120  //scan window in milliseconds
#define SCAN_INTERVAL_MS			10000  // scan interval in milliseconds
// Low activity parameters
#define ADV_INTERVAL_MS_MIN_LOW_ACTIVITY				10000 // Advertisement interval in milliseconds
#define ADV_INTERVAL_MS_MAX_LOW_ACTIVITY				10100 // Advertisement interval in milliseconds
#define SCAN_WINDOW_MS_LOW_ACTIVITY				100  //scan window in milliseconds
#define SCAN_INTERVAL_MS_LOW_ACTIVITY			10000  // scan interval in milliseconds




#define CONNECTABLE_ADV_INTERVAL_MIN    		BT_GAP_MS_TO_ADV_INTERVAL(ADV_INTERVAL_MIN)
#define CONNECTABLE_ADV_INTERVAL_MAX    		BT_GAP_MS_TO_ADV_INTERVAL(ADV_INTERVAL_MAX)
#define SCAN_WINDOW								BT_GAP_MS_TO_SCAN_WINDOW(SCAN_WINDOW_MS)  //scan window in 0.625 mus
#define SCAN_INTERVAL							BT_GAP_MS_TO_SCAN_INTERVAL(SCAN_INTERVAL_MS)  // scan interval in 0.625 mus
#define CONNECTABLE_ADV_INTERVAL_MIN_LOW_ACTIVITY    BT_GAP_MS_TO_ADV_INTERVAL(ADV_INTERVAL_MS_MIN_LOW_ACTIVITY)
#define CONNECTABLE_ADV_INTERVAL_MAX_LOW_ACTIVITY    BT_GAP_MS_TO_ADV_INTERVAL(ADV_INTERVAL_MS_MAX_LOW_ACTIVITY)
#define SCAN_WINDOW_LOW_ACTIVITY					BT_GAP_MS_TO_SCAN_WINDOW(SCAN_WINDOW_MS_LOW_ACTIVITY)  //scan window in 0.625 mus
#define SCAN_INTERVAL_LOW_ACTIVITY				BT_GAP_MS_TO_SCAN_INTERVAL(SCAN_INTERVAL_MS_LOW_ACTIVITY)  // scan interval in 0.625 mus
#define HIGH_ACTIVITY				1
#define LOW_ACTIVITY				0
#define INITIAL_MODE				HIGH_ACTIVITY  //1 High Activity, 0 Low Activity
#define COMMAND_TARGET_BROADCAST	0xff
#define COMMAND_DATA_MAX_LEN		31
#define COMMAND_QUEUE_DEPTH		4
#define RADIO_PARAMS_STORAGE_KEY	"dsa/radio"
#define RADIO_STATUS_SCAN_RUNTIME_ERROR	BIT(0)
#define RADIO_STATUS_NUS_ERROR		BIT(1)
#define RADIO_STATUS_SCAN_CONFIG_ERROR	BIT(2)
#define BLE_UPDATE_ADV_ERROR		BIT(0)
#define BLE_UPDATE_SCAN_ERROR		BIT(1)
#define BLE_UPDATE_STATUS_ERROR		BIT(2)



static uint8_t mfg_data[] = { 0xff, 0x00, 0x00 };

static const struct bt_data ad[] = {
	//BT_DATA_BYTES(BT_DATA_FLAGS, (BT_LE_AD_GENERAL | BT_LE_AD_NO_BREDR)),
	BT_DATA(BT_DATA_NAME_COMPLETE, CONFIG_BT_DEVICE_NAME, strlen(CONFIG_BT_DEVICE_NAME)),
	BT_DATA(BT_DATA_MANUFACTURER_DATA, mfg_data, sizeof(mfg_data)),
};

struct radio_params {
	uint16_t	adv_interval_min;
	uint16_t	adv_interval_max;
	uint16_t	adv_interval_min_lowactivity;
	uint16_t	adv_interval_max_lowactivity;
	uint16_t	scan_interval;
	uint16_t	scan_interval_lowactivity;
	uint16_t	scan_window;
	uint16_t	scan_window_lowactivity;
	uint8_t		mode;
};

static struct radio_params params_radio;

static struct bt_le_scan_param scan_params;
static struct bt_le_adv_param adv_params;

enum target_action {
    ACTION_NONE = 0,
    ACTION_DSA,
    ACTION_DST,
    ACTION_DSZ,
};

struct target_device {
    const char *name;
    enum target_action action;
};

static const struct target_device target_devices[] = {
    { .name = "DSA",    .action = ACTION_DSA },
    { .name = "DSZ", 	.action = ACTION_DSZ },
    { .name = "DST", 	.action = ACTION_DST },
};
struct name_check {
    	bool found;
    	enum target_action action;
	};

struct command_msg {
	uint8_t len;
	uint8_t data[COMMAND_DATA_MAX_LEN];
};

static void command_work_handler(struct k_work *work);
static int radio_status_set(uint8_t mask, bool active);
static void radio_status_set_local(uint8_t mask, bool active);
static void adv_prepare_status_data(void);

K_MSGQ_DEFINE(command_msgq, sizeof(struct command_msg), COMMAND_QUEUE_DEPTH, 1);
static K_WORK_DEFINE(command_work, command_work_handler);

bool radio_params_hardcoded=0;

void set_ble_params(struct radio_params *params);
static uint8_t update_ble_params(struct bt_le_scan_param *scan_params, struct bt_le_adv_param *adv_params);
static int radio_params_validate(const struct radio_params *params);
static int scan_init(void);



void set_radio_params_init(void)
{
	params_radio.adv_interval_min 			= CONNECTABLE_ADV_INTERVAL_MIN;
	params_radio.adv_interval_max 			= CONNECTABLE_ADV_INTERVAL_MAX;
	params_radio.adv_interval_min_lowactivity 	= CONNECTABLE_ADV_INTERVAL_MIN_LOW_ACTIVITY;
	params_radio.adv_interval_max_lowactivity 	= CONNECTABLE_ADV_INTERVAL_MAX_LOW_ACTIVITY;
	params_radio.scan_interval 			= (uint16_t)SCAN_INTERVAL;
	params_radio.scan_interval_lowactivity 	= (uint16_t)SCAN_INTERVAL_LOW_ACTIVITY;
	params_radio.scan_window 			= (uint16_t)SCAN_WINDOW;
	params_radio.scan_window_lowactivity 	= (uint16_t)SCAN_WINDOW_LOW_ACTIVITY;
	params_radio.mode 					= INITIAL_MODE;
	radio_params_hardcoded = 1;
}

static bool name_check_cb(struct bt_data *data, void *user_data)
{
    struct name_check *check = user_data;

    if (data->type != BT_DATA_NAME_COMPLETE &&
        data->type != BT_DATA_NAME_SHORTENED) {
        return true;
    }

    for (size_t i = 0; i < ARRAY_SIZE(target_devices); i++) {
        const char *target_name = target_devices[i].name;

        if (data->data_len == strlen(target_name) &&
            memcmp(data->data, target_name, data->data_len) == 0) {
            check->found = true;
            check->action = target_devices[i].action;
            return false;
        }
    }

    return true;
}

static bool scan_extract_data(struct bt_data *data, void *user_data)
{
	struct net_buf_simple *buf = user_data;

	if (data->type == BT_DATA_MANUFACTURER_DATA)
	{
		uint16_t copy_len = MIN(data->data_len, net_buf_simple_tailroom(buf));

		net_buf_simple_add_mem(buf, data->data, copy_len);
		if (copy_len < data->data_len) {
			printk("Command data truncated from %u to %u bytes\n",
			       data->data_len, copy_len);
		}
		return false; // Stop parsing further
	}

	return true; // Continue parsing other data fields    
 
}

static void radio_apply_command(uint8_t parameter, uint16_t value)
{
	int err;
	uint8_t update_errors;
	struct radio_params old_params_radio = params_radio;

	switch (parameter) {
	case P_ADV_INTERVAL_MS:
		params_radio.adv_interval_min = BT_GAP_MS_TO_ADV_INTERVAL(value);
		params_radio.adv_interval_max = BT_GAP_MS_TO_ADV_INTERVAL(value);
		break;
	case P_ADV_INTERVAL_LOWACTIVITY_MS:
		params_radio.adv_interval_min_lowactivity = BT_GAP_MS_TO_ADV_INTERVAL(value);
		params_radio.adv_interval_max_lowactivity = BT_GAP_MS_TO_ADV_INTERVAL(value);
		break;
	case P_SCAN_INTERVAL_MS:
		params_radio.scan_interval = BT_GAP_MS_TO_SCAN_INTERVAL(value);
		break;
	case P_SCAN_INTERVAL_LOWACTIVITY_MS:
		params_radio.scan_interval_lowactivity = BT_GAP_MS_TO_SCAN_INTERVAL(value);
		break;
	case P_SCAN_WINDOW_MS:
		params_radio.scan_window = BT_GAP_MS_TO_SCAN_WINDOW(value);
		break;
	case P_SCAN_WINDOW_LOWACTIVITY_MS:
		params_radio.scan_window_lowactivity = BT_GAP_MS_TO_SCAN_WINDOW(value);
		break;
	case P_RADIO_RESET_PARAMS:
		set_radio_params_init();
		break;
	case P_SET_RAD_ACTIVE:
		params_radio.mode = value ? HIGH_ACTIVITY : LOW_ACTIVITY;
		break;
	default:
		printk("Unknown radio parameter 0x%02x value %u\n", parameter, value);
		break;
	}

	if (memcmp(&old_params_radio, &params_radio, sizeof(params_radio)) != 0) {
		err = radio_params_validate(&params_radio);
		if (err) {
			printk("Rejecting invalid radio parameters (err %d)\n", err);
			params_radio = old_params_radio;
			return;
		}

		set_ble_params(&params_radio);
		update_errors = update_ble_params(&scan_params, &adv_params);
		if (update_errors & (BLE_UPDATE_ADV_ERROR | BLE_UPDATE_SCAN_ERROR)) {
			printk("Radio parameter update had error flags 0x%02x, restoring old parameters\n",
			       update_errors);

			params_radio = old_params_radio;
			set_ble_params(&params_radio);
			update_errors = update_ble_params(&scan_params, &adv_params);
			if (update_errors & BLE_UPDATE_ADV_ERROR) {
				printk("Failed to restore advertising parameters, not saving radio parameters\n");
			} else if (update_errors & BLE_UPDATE_SCAN_ERROR) {
				printk("Failed to restore scan parameters, not saving radio parameters\n");
			}
			return;
		}
		if (update_errors & BLE_UPDATE_STATUS_ERROR) {
			printk("Radio status advertising data update failed, keeping accepted parameters\n");
		}

		err = radio_params_save();
		if (err) {
			printk("Failed to save radio parameters (err %d)\n", err);
		}
	}
}

int radio_params_load(void)
{
	return param_storage_load(RADIO_PARAMS_STORAGE_KEY,
				  &params_radio, sizeof(params_radio));
}

int radio_params_save(void)
{
	return param_storage_save(RADIO_PARAMS_STORAGE_KEY,
				  &params_radio, sizeof(params_radio));
}

static void evaluate_command_data(const uint8_t *data, uint8_t len)
{
	for (uint8_t offset = 0; offset + 2 < len; offset += 3) {
		uint8_t parameter = data[offset];
		uint16_t value = sys_get_be16(&data[offset + 1]);

		printk("Command parameter 0x%02x value %u\n", parameter, value);

		switch (parameter & P_BASE_MASK) {
		case P_BASE_MAIN:
			led_apply_command(parameter, value);
			break;
		case P_BASE_NETWORK:
			network_apply_command(parameter, value);
			break;
		case P_BASE_RADIO:
			radio_apply_command(parameter, value);
			break;
		default:
			printk("Unknown parameter base 0x%02x for parameter 0x%02x\n",
			       parameter & P_BASE_MASK, parameter);
			break;
		}
	}

	if ((len % 3) != 0) {
		printk("Ignoring %u incomplete command byte(s)\n", len % 3);
	}
}

static void radio_evaluate_command_data(const uint8_t *data, uint8_t len)
{
	uint8_t target;

	if (len < 1) {
		printk("Command data missing target byte\n");
		return;
	}

	target = data[0];
	if (target != mfg_data[ADV_POS_ID] && target != COMMAND_TARGET_BROADCAST) {
		printk("Ignoring command for target 0x%02x, own id 0x%02x\n",
		       target, mfg_data[ADV_POS_ID]);
		return;
	}

	evaluate_command_data(&data[1], len - 1);
}

static void command_work_handler(struct k_work *work)
{
	struct command_msg msg;

	ARG_UNUSED(work);

	while (k_msgq_get(&command_msgq, &msg, K_NO_WAIT) == 0) {
		radio_evaluate_command_data(msg.data, msg.len);
	}
}

static void enqueue_command_from_ad(struct net_buf_simple *buf)
{
	int err;
	struct command_msg msg = { 0 };
	struct net_buf_simple ad_temp;
	NET_BUF_SIMPLE_DEFINE(command_buf, COMMAND_DATA_MAX_LEN);

	net_buf_simple_clone(buf, &ad_temp);
	bt_data_parse(&ad_temp, scan_extract_data, &command_buf);

	if (command_buf.len == 0) {
		printk("Command advertisement has no manufacturer data\n");
		return;
	}

	msg.len = command_buf.len;
	memcpy(msg.data, command_buf.data, msg.len);

	err = k_msgq_put(&command_msgq, &msg, K_NO_WAIT);
	if (err) {
		printk("Command queue full, dropping command (err %d)\n", err);
		return;
	}

	k_work_submit(&command_work);
}

static void scan_cb(const bt_addr_le_t *addr, int8_t rssi, uint8_t adv_type,
		    struct net_buf_simple *buf)
{
	struct net_buf_simple ad_temp;
	struct name_check check = {
		.action = ACTION_NONE,
		.found = false,
	};
	net_buf_simple_clone(buf, &ad_temp);
	bt_data_parse(&ad_temp, name_check_cb, &check);

	if (check.found) {
		printk("Found target device DSA\n");
		switch (check.action) {
		case ACTION_DSA:
		case ACTION_DST:
			network_evaluate_contact(addr, rssi, adv_type, buf);	
			break;

		case ACTION_DSZ:
			enqueue_command_from_ad(buf);
			break;
		default:
			break;
		}	
	}
    /* Do follow-up logic here, not inside name_check_cb */
}

static int radio_params_validate(const struct radio_params *params)
{
	// TODO: Add validation for parameter ranges if needed
	if (params->mode != HIGH_ACTIVITY && params->mode != LOW_ACTIVITY) {
		return -EINVAL;
	}

	if (params->adv_interval_min == 0 ||
	    params->adv_interval_max == 0 ||
	    params->adv_interval_min_lowactivity == 0 ||
	    params->adv_interval_max_lowactivity == 0 ||
	    params->scan_interval == 0 ||
	    params->scan_interval_lowactivity == 0 ||
	    params->scan_window == 0 ||
	    params->scan_window_lowactivity == 0) {
		return -EINVAL;
	}

	if (params->adv_interval_min > params->adv_interval_max ||
	    params->adv_interval_min_lowactivity > params->adv_interval_max_lowactivity) {
		return -EINVAL;
	}

	if (params->scan_window > params->scan_interval ||
	    params->scan_window_lowactivity > params->scan_interval_lowactivity) {
		return -EINVAL;
	}

	return 0;
}

/* Advertising is required. Scan failures are degraded mode and are exposed
 * through the radio status byte.
 */
static uint8_t update_ble_params(struct bt_le_scan_param *parameters_scan, struct bt_le_adv_param *parameters_adv)
{
	int err;
	uint8_t errors = 0;
	bool status_changed = false;

	err = bt_le_adv_stop();
	if (err && err != -EALREADY) {
		printk("Advertising stop before parameter update failed (err %d)\n", err);
		errors |= BLE_UPDATE_ADV_ERROR;
	}

	err = bt_le_scan_stop();
	if (err && err != -EALREADY) {
		printk("Scan stop before parameter update failed (err %d)\n", err);
		radio_status_set_local(RADIO_STATUS_SCAN_RUNTIME_ERROR, true);
		status_changed = true;
		errors |= BLE_UPDATE_SCAN_ERROR;
	}

	err = bt_le_adv_start(parameters_adv, ad, ARRAY_SIZE(ad), NULL, 0);
	if (err && err != -EALREADY) {
		printk("Advertising parameter update failed (err %d)\n", err);
		errors |= BLE_UPDATE_ADV_ERROR;
	}

	err = bt_le_scan_start(parameters_scan, scan_cb);
	if (err && err != -EALREADY) {
		printk("Scan parameter update failed (err %d)\n", err);
		radio_status_set_local(RADIO_STATUS_SCAN_RUNTIME_ERROR, true);
		status_changed = true;
		errors |= BLE_UPDATE_SCAN_ERROR;
	} else {
		radio_status_set_local(RADIO_STATUS_SCAN_RUNTIME_ERROR, false);
		status_changed = true;
	}

	if (status_changed && !(errors & BLE_UPDATE_ADV_ERROR)) {
		err = adv_update();
		if (err) {
			errors |= BLE_UPDATE_STATUS_ERROR;
		}
	}

	return errors;
}

static int scan_init(void)
{
	int err;
	int failed_entries = 0;

	for (size_t i = 0; i < ARRAY_SIZE(known_device_table); i++) {
		err = bt_le_filter_accept_list_add(&known_device_table[i].addr);
		if (err) {
			printk("Failed to add device %u to filter list (err %d)\n", i, err);
			failed_entries++;
		}
	}

	if (failed_entries == ARRAY_SIZE(known_device_table)) {
		return -ENODEV;
	}

	return 0;
}

void adv_init(void)
{
	adv_params.id = 0U;
	adv_params.sid = 0U;
	adv_params.secondary_max_skip = 0U;
	adv_params.options = BT_LE_ADV_OPT_CONN | BT_LE_ADV_OPT_USE_IDENTITY;
	mfg_data[ADV_POS_ID] = get_device_id();
	adv_prepare_status_data();
}

int adv_update(void)
{
	int err;
	uint8_t old_mfg_data[sizeof(mfg_data)];

	memcpy(old_mfg_data, mfg_data, sizeof(mfg_data));

	adv_prepare_status_data();

	err = bt_le_adv_update_data(ad, ARRAY_SIZE(ad), NULL, 0);
	if (err) {
		memcpy(mfg_data, old_mfg_data, sizeof(mfg_data));
		printk("Advertising data update failed (err %d)\n", err);
		return err;
	}

	return 0;
}

static int radio_status_set(uint8_t mask, bool active)
{
	radio_status_set_local(mask, active);
	return adv_update();
}

static void radio_status_set_local(uint8_t mask, bool active)
{
	device_set_radio_status_bit(mask, active);
}

static void adv_prepare_status_data(void)
{
	mfg_data[ADV_POS_RADIO_STATUS] = device_get_radio_status();
	mfg_data[ADV_POS_NETWORK_STATUS] = device_get_network_status();
}

void set_ble_params(struct radio_params *params)
{
	scan_params.type = BT_LE_SCAN_TYPE_PASSIVE;
	scan_params.options = BT_LE_SCAN_OPT_FILTER_ACCEPT_LIST;
	switch(params->mode)
			{
				case LOW_ACTIVITY:
				{
				    adv_params.interval_min   = params->adv_interval_min_lowactivity;
					adv_params.interval_max   = params->adv_interval_max_lowactivity;
				    scan_params.interval = params->scan_interval_lowactivity;
				    scan_params.window = params->scan_window_lowactivity;
					break;
				}
				case HIGH_ACTIVITY:
				{
					adv_params.interval_min   = params->adv_interval_min;
					adv_params.interval_max   = params->adv_interval_max;
					scan_params.interval = params->scan_interval;
					scan_params.window = params->scan_window;
				    break;
				}
			}
}

int radio_init(void)
{
  	int err;
	int load_err;

	err = bt_enable(NULL);
	if (err) {
		printk("Bluetooth init failed (err %d)\n", err);
		return err;
	}

	printk("Bluetooth initialized\n");

	err = nus_service_init();
	if (err) {
		printk("NUS init failed (err %d), continuing without NUS\n", err);
		radio_status_set_local(RADIO_STATUS_NUS_ERROR, true);
	} else {
		radio_status_set_local(RADIO_STATUS_NUS_ERROR, false);
		printk("NUS initialized\n");
	}
	set_radio_params_init();
	load_err = radio_params_load();
	if (load_err == -ENOENT) {
		printk("No stored radio parameters, using defaults\n");
	} else if (load_err) {
		printk("Failed to load radio parameters (err %d), using defaults\n", load_err);
	} else {
		err = radio_params_validate(&params_radio);
		if (err) {
			printk("Stored radio parameters invalid (err %d), using defaults\n", err);
			set_radio_params_init();
		}
	}
	err = scan_init();
	if (err) {
		radio_status_set_local(RADIO_STATUS_SCAN_CONFIG_ERROR, true);
	} else {
		radio_status_set_local(RADIO_STATUS_SCAN_CONFIG_ERROR, false);
	}
	adv_init();
	return 0;
}

int radio_start(void)
{
    int err;

	set_ble_params(&params_radio);
	/* Start advertising */
	err = bt_le_adv_start(&adv_params, ad, ARRAY_SIZE(ad),
				      NULL, 0);
	if (err) {
		printk("Advertising failed to start (err %d)\n", err);
		return err;
	}

	
	err = bt_le_scan_start(&scan_params, scan_cb);
	if (err) {
		printk("Starting scanning failed (err %d)\n", err);
		radio_status_set(RADIO_STATUS_SCAN_RUNTIME_ERROR, true);
		return 0;
	}

	radio_status_set(RADIO_STATUS_SCAN_RUNTIME_ERROR, false);


    
    return 0;
}


static void radio_disconnected(struct bt_conn *conn, uint8_t reason)
{
	ARG_UNUSED(conn);

	printk("Connection disconnected, advertising restart waits for recycled callback (reason 0x%02x)\n",
	       reason);
}

static void radio_recycled(void)
{
	int err;

	printk("Connection object recycled, restarting advertising\n");
	err = bt_le_adv_start(&adv_params, ad, ARRAY_SIZE(ad), NULL, 0);
	if (err) {
		printk("Advertising failed to restart (err %d)\n", err);
	} else {
		printk("Advertising restarted\n");
	}
}

BT_CONN_CB_DEFINE(radio_conn_callbacks) = {
	.disconnected = radio_disconnected,
	.recycled = radio_recycled,
};
```
